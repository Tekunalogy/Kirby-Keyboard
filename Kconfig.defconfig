## Kconfig.defconfig
```kconfig
if SHIELD_KIRBY

config ZMK_KEYBOARD_NAME
    default "KIRBY-KEEB"

config BT_DEVICE_NAME
	default ZMK_KEYBOARD_NAME

config USB_DEVICE_PRODUCT
	default ZMK_KEYBOARD_NAME

endif
```
